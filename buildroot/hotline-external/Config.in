## buildroot/hotline-external/Config.in
```kconfig
source "$BR2_EXTERNAL_HOTLINE_PATH/package/python-kivy/Config.in"
source "$BR2_EXTERNAL_HOTLINE_PATH/package/python-cython-hotline/Config.in.host"
```

## buildroot/hotline-external/configs/hotline-rpi_defconfig
```kconfig
BR2_arm=y

# pre v1.2 Pi2
#BR2_cortex_a7=y
#BR2_ARM_EABIHF=y

# v1.2 Pi2 & Pi3
BR2_cortex_a53=y

BR2_ARM_FPU_NEON_VFPV4=y

BR2_CCACHE=y
BR2_TOOLCHAIN_BUILDROOT_CXX=y
BR2_TOOLCHAIN_BUILDROOT_GLIBC=y
BR2_GCC_VERSION_8_X=y

# Linux headers same as kernel, a 4.14 series
BR2_PACKAGE_HOST_LINUX_HEADERS_CUSTOM_4_14=y

BR2_LINUX_KERNEL=y
BR2_LINUX_KERNEL_CUSTOM_TARBALL=y
BR2_LINUX_KERNEL_CUSTOM_TARBALL_LOCATION="$(call github,raspberrypi,linux,865ddc1393f558198e7e7ce70928ff2e49c4f7f6)/linux-865ddc1393f558198e7e7ce70928ff2e49c4f7f6.tar.gz"
BR2_LINUX_KERNEL_DEFCONFIG="bcm2709"
BR2_LINUX_KERNEL_DTS_SUPPORT=y
BR2_LINUX_KERNEL_DTS_OVERLAYS_SUPPORT=y

# Raspberry Pi 2B v1.2 and Pi 3B
BR2_LINUX_KERNEL_INTREE_DTS_NAME="bcm2709-rpi-2-b bcm2710-rpi-3-b bcm2710-rpi-3-b-plus"

BR2_PACKAGE_RPI_FIRMWARE=y
BR2_PACKAGE_RPI_FIRMWARE_X=y
BR2_PACKAGE_RPI_FIRMWARE_INSTALL_DTB_OVERLAYS=y

# Framebuffer support
BR2_PACKAGE_DIRECTFB=y
BR2_PACKAGE_DIRECTFB_DEBUG_SUPPORT=n
BR2_PACKAGE_DIRECTFB_PS2MOUSE=n
BR2_PACKAGE_DIRECTFB_SERIALMOUSE=n
BR2_PACKAGE_DIRECTFB_KEYBOARD=n

# SDL2
BR2_PACKAGE_SDL2=y
BR2_PACKAGE_SDL2_IMAGE=y
BR2_PACKAGE_SDL2_MIXER=y
BR2_PACKAGE_SDL2_TTF=y
BR2_PACKAGE_SDL2_DIRECTFB=n
BR2_PACKAGE_SDL2_OPENGLES=y

# Python
BR2_PACKAGE_PYTHON3=y
BR2_PACKAGE_PYTHON_REQUESTS=y
BR2_PACKAGE_PYTHON_SERIAL=y
BR2_PACKAGE_PYTHON_KIVY=y
BR2_PACKAGE_PYTHON_RPI_GPIO=y

# Misc
BR2_PACKAGE_MINICOM=y
BR2_PACKAGE_NANO=y
BR2_PACKAGE_PPPD=y
BR2_TARGET_GENERIC_ROOT_PASSWD="hotline"
BR2_TARGET_GENERIC_HOSTNAME="hotline"
BR2_TARGET_GENERIC_ISSUE="Welcome to Hotline"
BR2_TARGET_GENERIC_GETTY=n

# Helpful for Debugging
#BR2_PACKAGE_STRACE=y
#BR2_STRIP_strip=n
BR2_PACKAGE_EVTEST=y
BR2_SYSTEM_DHCP="eth0"
BR2_PACKAGE_WPA_SUPPLICANT=y
BR2_PACKAGE_RPI_WIFI_FIRMWARE=y
BR2_PACKAGE_IPROUTE2=y
BR2_PACKAGE_DROPBEAR=y
BR2_PACKAGE_DROPBEAR_CLIENT=n
BR2_PACKAGE_DROPBEAR_DISABLE_REVERSEDNS=y
BR2_PACKAGE_DROPBEAR_SMALL=n

# Filesystem / image
BR2_TARGET_ROOTFS_EXT2=y
BR2_TARGET_ROOTFS_EXT2_4=y
BR2_TARGET_ROOTFS_EXT2_SIZE="120M"
BR2_TARGET_ROOTFS_TAR=n
BR2_ROOTFS_OVERLAY="$(BR2_EXTERNAL_HOTLINE_PATH)/board/hotline-rpi/rootfs_overlay"
BR2_ROOTFS_DEVICE_CREATION_DYNAMIC_DEVTMPFS=y
BR2_ROOTFS_POST_BUILD_SCRIPT="$(BR2_EXTERNAL_HOTLINE_PATH)/board/hotline-rpi/post-build.sh"
BR2_ROOTFS_POST_IMAGE_SCRIPT="$(BR2_EXTERNAL_HOTLINE_PATH)/board/hotline-rpi/post-image.sh"

# Required tools to create the SD image
BR2_PACKAGE_HOST_DOSFSTOOLS=y
BR2_PACKAGE_HOST_GENIMAGE=y
BR2_PACKAGE_HOST_MTOOLS=y
```

## buildroot/hotline-external/package/python-cython-hotline/Config.in.host
```kconfig
config BR2_PACKAGE_HOST_PYTHON_CYTHON_HOTLINE
	bool "host python-cython-hotline"
	help
	  The Cython compiler for writing C extensions for the Python
	  language.

	  http://cython.org/
```

## buildroot/hotline-external/package/python-kivy/Config.in
```kconfig
config BR2_PACKAGE_PYTHON_KIVY
	bool "python-kivy"
	depends on BR2_TOOLCHAIN_USES_GLIBC
	select BR2_PACKAGE_HOST_PYTHON_CYTHON_HOTLINE
	select BR2_PACKAGE_LIBPNG # runtime
	select BR2_PACKAGE_MTDEV # runtime
	select BR2_PACKAGE_PYTHON_DOCUTILS # runtime
	select BR2_PACKAGE_PYTHON_PYGMENTS # runtime
	select BR2_PACKAGE_RPI_USERLAND # GL drivers
	help
	  A software library for rapid development of
	  hardware-accelerated multitouch applications.

	  http://kivy.org

comment "python-kivy needs a glibc toolchain"
	depends on !BR2_TOOLCHAIN_USES_GLIBC
```
